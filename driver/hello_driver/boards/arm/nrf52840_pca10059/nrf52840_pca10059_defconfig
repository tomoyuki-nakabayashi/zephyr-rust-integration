## driver/hello_driver/boards/arm/nrf52840_pca10059/nrf52840_pca10059_defconfig
```kconfig
CONFIG_ARM=y
CONFIG_SOC_FAMILY_NRF=y
CONFIG_SOC_SERIES_NRF52X=y
CONFIG_SOC_NRF52840_QIAA=y
CONFIG_BOARD_NRF52840_PCA10059=y

# Enable MPU
CONFIG_ARM_MPU=y

# Enable UART driver, needed for CDC ACM
CONFIG_SERIAL=y
CONFIG_UART_NRFX=y
CONFIG_UART_0_NRF_UART=y
CONFIG_UART_INTERRUPT_DRIVEN=y

# enable console
CONFIG_CONSOLE=y
CONFIG_UART_CONSOLE=y

# additional board options
CONFIG_GPIO_AS_PINRESET=y

# enable SPI driver
CONFIG_SPI=y
CONFIG_SPI_INIT_PRIORITY=70
CONFIG_SPI_LOG_LEVEL_INF=y
CONFIG_SPI_LOG_LEVEL=3
CONFIG_SPI_0=y
CONFIG_SPI_0_OP_MODES=1
CONFIG_SPI_NRFX=y
CONFIG_SPI_0_NRF_SPI=y

# network
CONFIG_BT=n

CONFIG_NET_TX_STACK_SIZE=4096
CONFIG_NET_LOG=y

CONFIG_NET_IPV4=n
CONFIG_NET_CONFIG_NEED_IPV4=n

CONFIG_TEST_RANDOM_GENERATOR=n
CONFIG_ENTROPY_NRF5_RNG=y

CONFIG_SYS_CLOCK_TICKS_PER_SEC=1000
```
